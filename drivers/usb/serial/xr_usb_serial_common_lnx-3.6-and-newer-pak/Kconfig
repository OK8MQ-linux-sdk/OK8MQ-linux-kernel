## drivers/usb/serial/xr_usb_serial_common_lnx-3.6-and-newer-pak/Kconfig
```kconfig
menu "XR USB to serials drivers"

config USB_SERIAL_XR
        tristate

config XR_USB_SERIAL_COMMON
        tristate "XR USB to serial ports driver"
        select USB_SERIAL_XR
        help
          This driver adds support for XR USB to serial ports

          To compile this driver as module, choose M here:


endmenu
```
